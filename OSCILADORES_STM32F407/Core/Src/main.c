/* USER CODE BEGIN Header */
/**
  ******************************************************************************
  * @file           : main.c
  * @brief          : Main program body
  ******************************************************************************
  * @attention
  *
  * <h2><center>&copy; Copyright (c) 2020 STMicroelectronics.
  * All rights reserved.</center></h2>
  *
  * This software component is licensed by ST under BSD 3-Clause license,
  * the "License"; You may not use this file except in compliance with the
  * License. You may obtain a copy of the License at:
  *                        opensource.org/licenses/BSD-3-Clause
  *
  ******************************************************************************
  */
/* USER CODE END Header */

/* Includes ------------------------------------------------------------------*/
#include "main.h"
#include "dac.h"
#include "tim.h"
#include "usart.h"
#include "gpio.h"

/* Private includes ----------------------------------------------------------*/
/* USER CODE BEGIN Includes */
#include "osc_dac_lfs.h"
/* USER CODE END Includes */

/* Private typedef -----------------------------------------------------------*/
/* USER CODE BEGIN PTD */

/* USER CODE END PTD */

/* Private define ------------------------------------------------------------*/
/* USER CODE BEGIN PD */
//#define NOTA_C1 24
/* USER CODE END PD */

/* Private macro -------------------------------------------------------------*/
/* USER CODE BEGIN PM */

/* USER CODE END PM */

/* Private variables ---------------------------------------------------------*/

/* USER CODE BEGIN PV */
//const unsigned long tabla_seno_vieja[] = {686,689,692,695,698,702,705,708,711,714,717,721,724,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1283,
//									1285,1286,1288,1289,1291,1292,1293,1295,1296,1298,1299,1300,1302,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1282,
//									1281,1279,1277,1276,1274,1273,1271,1270,1268,1266,1265,1263,1261,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667,
//									664,661,658,655,652,648,645,642,639,636,632,629,626,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21,
//									20,19,19,18,17,17,16,15,15,14,13,13,12,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484,
//									487,490,493,496,499,502,505,508,511,514,517,520,523,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681,};
//
//const unsigned long tabla_cuadrada_vieja[] = {1365,1365,1365,1365,1365,1365,1365,1365,1365,1365,1365,1365,1365,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1365,
//										1365,1365,1365,1365,1365,1365,1365,1365,1365,1365,1365,1365,1365,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1365,
//										1365,1365,1365,1365,1365,1365,1365,1365,1365,1365,1365,1365,1365,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1365,
//										1365,1365,1365,1365,1365,1365,1365,1365,1365,1365,1365,1365,1365,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0,
//										0,0,0,0,0,0,0,0,0,0,0,0,0,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0,};
//
//const unsigned long tabla_sierra_vieja[] = {0,1,2,3,4,5,6,7,8,9,10,11,12,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254,
//										255,256,257,258,259,260,261,262,263,264,266,267,268,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482,
//										483,484,485,486,487,488,489,490,491,492,494,495,496,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577,
//										578,579,580,581,582,583,584,585,586,587,588,589,590,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805,
//										806,807,808,809,810,811,812,813,814,815,816,817,818,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1027,
//										1028,1029,1030,1031,1032,1033,1034,1035,1036,1037,1038,1039,1040,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1210,
//										1211,1212,1213,1214,1215,1216,1217,1218,1219,1220,1221,1222,1223,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1365,};

//uint16_t phase = 0;
uint8_t flag_dac = 0;

uint8_t read_tecla[3] = {0, 0, 0};
uint8_t last_tecla[3] = {0, 0, 0};

uint8_t testNota[3] = {NOTA_C1, 36, 60};
/* USER CODE END PV */

/* Private function prototypes -----------------------------------------------*/
void SystemClock_Config(void);
/* USER CODE BEGIN PFP */

/* USER CODE END PFP */

/* Private user code ---------------------------------------------------------*/
/* USER CODE BEGIN 0 */

/* USER CODE END 0 */

/**
  * @brief  The application entry point.
  * @retval int
  */
int main(void)
{
  /* USER CODE BEGIN 1 */

  /* USER CODE END 1 */

  /* MCU Configuration--------------------------------------------------------*/

  /* Reset of all peripherals, Initializes the Flash interface and the Systick. */
  HAL_Init();

  /* USER CODE BEGIN Init */

  /* USER CODE END Init */

  /* Configure the system clock */
  SystemClock_Config();

  /* USER CODE BEGIN SysInit */

  /* USER CODE END SysInit */

  /* Initialize all configured peripherals */
  MX_GPIO_Init();
  MX_DAC_Init();
  MX_TIM2_Init();
  MX_USART1_UART_Init();
  /* USER CODE BEGIN 2 */
  HAL_TIM_Base_Start_IT(&htim2);
  //HAL_DAC_Start(&hdac, DAC_CHANNEL_1);
  osc_dac_init(&hdac, DAC_CHANNEL_1);
  osc_setRatios(100, 100, 100);

  /* USER CODE END 2 */

  /* Infinite loop */
  /* USER CODE BEGIN WHILE */
  while (1)
  {

	  read_tecla[0] = HAL_GPIO_ReadPin(DO_GPIO_Port, DO_Pin);
	  read_tecla[1] = HAL_GPIO_ReadPin(REb_GPIO_Port, REb_Pin);
	  read_tecla[2] = HAL_GPIO_ReadPin(RE_GPIO_Port, RE_Pin);

	  for (uint8_t i = 0; i < 3; i++){
		  if (!read_tecla[i] && last_tecla[i]){
			  osc_setNote(NOTA_C1 + i);
//			  osc_setNote(testNota[i]);
		  }else if(read_tecla[i] && !last_tecla[i]){
			  osc_setNote(0);
		  }
		  last_tecla[i]= read_tecla[i];
	  }//end for

	  if (flag_dac != 0){
		  osc_dac_update();
		  flag_dac = 0;
	  }
    /* USER CODE END WHILE */

    /* USER CODE BEGIN 3 */
  }
  /* USER CODE END 3 */
}

/**
  * @brief System Clock Configuration
  * @retval None
  */
void SystemClock_Config(void)
{
  RCC_OscInitTypeDef RCC_OscInitStruct = {0};
  RCC_ClkInitTypeDef RCC_ClkInitStruct = {0};

  /** Configure the main internal regulator output voltage
  */
  __HAL_RCC_PWR_CLK_ENABLE();
  __HAL_PWR_VOLTAGESCALING_CONFIG(PWR_REGULATOR_VOLTAGE_SCALE1);
  /** Initializes the CPU, AHB and APB busses clocks
  */
  RCC_OscInitStruct.OscillatorType = RCC_OSCILLATORTYPE_HSE;
  RCC_OscInitStruct.HSEState = RCC_HSE_ON;
  RCC_OscInitStruct.PLL.PLLState = RCC_PLL_ON;
  RCC_OscInitStruct.PLL.PLLSource = RCC_PLLSOURCE_HSE;
  RCC_OscInitStruct.PLL.PLLM = 4;
  RCC_OscInitStruct.PLL.PLLN = 168;
  RCC_OscInitStruct.PLL.PLLP = RCC_PLLP_DIV2;
  RCC_OscInitStruct.PLL.PLLQ = 7;
  if (HAL_RCC_OscConfig(&RCC_OscInitStruct) != HAL_OK)
  {
    Error_Handler();
  }
  /** Initializes the CPU, AHB and APB busses clocks
  */
  RCC_ClkInitStruct.ClockType = RCC_CLOCKTYPE_HCLK|RCC_CLOCKTYPE_SYSCLK
                              |RCC_CLOCKTYPE_PCLK1|RCC_CLOCKTYPE_PCLK2;
  RCC_ClkInitStruct.SYSCLKSource = RCC_SYSCLKSOURCE_PLLCLK;
  RCC_ClkInitStruct.AHBCLKDivider = RCC_SYSCLK_DIV1;
  RCC_ClkInitStruct.APB1CLKDivider = RCC_HCLK_DIV4;
  RCC_ClkInitStruct.APB2CLKDivider = RCC_HCLK_DIV2;

  if (HAL_RCC_ClockConfig(&RCC_ClkInitStruct, FLASH_LATENCY_5) != HAL_OK)
  {
    Error_Handler();
  }
}

/* USER CODE BEGIN 4 */
void HAL_TIM_PeriodElapsedCallback(TIM_HandleTypeDef *htim){
	if (htim->Instance == TIM2){
		flag_dac = 1;
	}
}
/* USER CODE END 4 */

/**
  * @brief  This function is executed in case of error occurrence.
  * @retval None
  */
void Error_Handler(void)
{
  /* USER CODE BEGIN Error_Handler_Debug */
  /* User can add his own implementation to report the HAL error return state */

  /* USER CODE END Error_Handler_Debug */
}

#ifdef  USE_FULL_ASSERT
/**
  * @brief  Reports the name of the source file and the source line number
  *         where the assert_param error has occurred.
  * @param  file: pointer to the source file name
  * @param  line: assert_param error line source number
  * @retval None
  */
void assert_failed(uint8_t *file, uint32_t line)
{
  /* USER CODE BEGIN 6 */
  /* User can add his own implementation to report the file name and line number,
     tex: printf("Wrong parameters value: file %s on line %d\r\n", file, line) */
  /* USER CODE END 6 */
}
#endif /* USE_FULL_ASSERT */

/************************ (C) COPYRIGHT STMicroelectronics *****END OF FILE****/
